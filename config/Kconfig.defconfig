## config/Kconfig.defconfig
```kconfig
# Copyright (c) 2022 The ZMK Contributors
# SPDX-License-Identifier: MIT

if SHIELD_CORNE

config ZMK_KEYBOARD_NAME
	default "HUNG_CORNE"

config ZMK_KSCAN_MATRIX_POLLING
	default y

config ZMK_KSCAN_DIRECT_POLLING
    default y

if ZMK_DISPLAY

config I2C
    default y

config SSD1306
    default y

config SSD1306_REVERSE_MODE
    default y

endif # ZMK_DISPLAY

if LVGL

config LVGL_VDB_SIZE
	default 100

config LVGL_DPI
	default 148

config LVGL_BITS_PER_PIXEL
	default 1

choice LVGL_COLOR_DEPTH
	default LVGL_COLOR_DEPTH_1
endchoice

endif # LVGL

endif # SHIELD_CORNE
```

## config/Kconfig.shield
```kconfig
# Copyright (c) 2022 The ZMK Contributors
# SPDX-License-Identifier: MIT

config SHIELD_CORNE
    def_bool $(shields_list_contains,corne)
```

## config/west.yml
```yaml
manifest:
  remotes:
    - name: zmkfirmware
      url-base: https://github.com/zmkfirmware
    - name: nvhung9
      url-base: https://github.com/nvhung9
    - name: nguyendown
      url-base: https://github.com/nguyendown
    - name: ftc
      url-base: https://github.com/ftc
    - name: infused-kim
      url-base: https://github.com/infused-kim
  projects:
    - name: zmk
      remote: ftc
      revision: mouse-ftc
      import: app/west.yml
  self:
    path: config
```
